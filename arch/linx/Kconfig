## arch/linx/Kconfig
```kconfig
# SPDX-License-Identifier: GPL-2.0-only
#
# LinxISA architecture (bring-up skeleton)
#

config 64BIT
	def_bool y

config 32BIT
	def_bool n

config LINX
	def_bool y
	select OF
	select OF_EARLY_FLATTREE
	select ARCH_HAS_BINFMT_FLAT
	select ARCH_HAS_SYSCALL_WRAPPER
	select GENERIC_ATOMIC64
	select UACCESS_MEMCPY
	select MODULES_USE_ELF_RELA
	select GENERIC_IRQ_SHOW
	select GENERIC_IRQ_PROBE
	select SPARSE_IRQ

config GENERIC_CALIBRATE_DELAY
	def_bool y

config GENERIC_HWEIGHT
	def_bool y

menu "Processor type and features"

config MMU
	bool "MMU support"
	default n
	help
	  Select if the LinxISA port should use paged MMU support. The bring-up
	  starts with NOMMU on QEMU `virt`.

config PGTABLE_LEVELS
	int
	default 4 if MMU
	default 2

config NR_CPUS
	int
	default 1

config LINX_DEBUG
	bool "Linx bring-up debug instrumentation"
	default n
	help
	  Enable verbose LinxISA bring-up debug logging and watchpoints wired into
	  core kernel subsystems (kthreads/workqueues/SLUB/initramfs/etc).

endmenu

source "kernel/Kconfig.hz"
```

## arch/linx/Kconfig.debug
```kconfig
# SPDX-License-Identifier: GPL-2.0-only
#
# LinxISA arch-specific debug options.
#

if LINX

config LINX_VIRT_UART_MARKERS
	bool "Verbose virt UART marker output"
	default n
	help
	  Enable extremely low-level bring-up instrumentation which writes
	  single-character markers directly to the QEMU LinxISA `virt` UART at
	  0x10000000.

	  This is intended for early boot debugging before the normal console is
	  available. It can be extremely verbose and should be disabled for
	  normal use.

endif # LINX
```

## arch/linx/configs/linxisa_virt_defconfig
```kconfig
CONFIG_LINX=y
CONFIG_64BIT=y
CONFIG_MMU=n
CONFIG_OF=y
CONFIG_OF_EARLY_FLATTREE=y
CONFIG_PRINTK=y
CONFIG_BINFMT_FLAT=y
```

## arch/linx/configs/linxisa_virt_mmu_defconfig
```kconfig
CONFIG_LINX=y
CONFIG_64BIT=y
CONFIG_MMU=y
CONFIG_BLK_DEV_INITRD=y
CONFIG_OF=y
CONFIG_OF_EARLY_FLATTREE=y
CONFIG_DEVTMPFS=y
CONFIG_DEVTMPFS_MOUNT=y
CONFIG_PRINTK=y
CONFIG_BINFMT_ELF=y
CONFIG_TTY=y
CONFIG_VIRTIO_MMIO=y
CONFIG_VIRTIO_MMIO_CMDLINE_DEVICES=y
CONFIG_VIRTIO_BLK=y
CONFIG_EXT2_FS=y
CONFIG_SERIAL_CORE=y
CONFIG_SERIAL_LINX_VIRT_UART=y
CONFIG_SERIAL_LINX_VIRT_UART_CONSOLE=y

# Bring-up hardening: avoid early-mm background threads until core trap/MM is stable.
# (kcompactd/compaction currently triggers kernel waitqueue faults in QEMU bring-up.)
# CONFIG_MIGRATION is not set
# CONFIG_COMPACTION is not set
```
